## boards/clockwise-esp32-hub75-idotmatrix/sdkconfig.defaults
```kconfig
CONFIG_ESPTOOLPY_FLASHSIZE_4MB=y
CONFIG_ESPTOOLPY_FLASHMODE_DIO=y
CONFIG_PARTITION_TABLE_CUSTOM=y
CONFIG_PARTITION_TABLE_CUSTOM_FILENAME="partitions/clockwise_app_4mb.csv"
CONFIG_ESP_MAIN_TASK_STACK_SIZE=6144
CONFIG_BT_ENABLED=y
CONFIG_BT_NIMBLE_ENABLED=y
CONFIG_BT_NIMBLE_ROLE_PERIPHERAL=y
CONFIG_BT_NIMBLE_ROLE_BROADCASTER=y
# CONFIG_BT_NIMBLE_ROLE_CENTRAL is not set
# CONFIG_BT_NIMBLE_ROLE_OBSERVER is not set
# CONFIG_BT_NIMBLE_GATT_CLIENT is not set
CONFIG_BT_NIMBLE_GATT_SERVER=y
CONFIG_BT_NIMBLE_MAX_CONNECTIONS=1
CONFIG_BT_NIMBLE_ATT_PREFERRED_MTU=517
CONFIG_COMPILER_OPTIMIZATION_SIZE=y
CONFIG_LV_USE_CLIB_MALLOC=y
CONFIG_LV_USE_GIF=y
CONFIG_LV_GIF_MAX_WIDTH=64
CONFIG_LV_GIF_MAX_HEIGHT=64
CONFIG_LV_USE_LODEPNG=y
CONFIG_LV_USE_FS_POSIX=y
CONFIG_LV_FS_POSIX_LETTER=77
CONFIG_LV_FS_POSIX_PATH=""
CONFIG_UART_ISR_IN_IRAM=y
```

## boards/clockwise-esp32-hub75/sdkconfig.defaults
```kconfig
CONFIG_ESPTOOLPY_FLASHSIZE_4MB=y
CONFIG_ESPTOOLPY_FLASHMODE_DIO=y
CONFIG_PARTITION_TABLE_CUSTOM_FILENAME="boards/clockwise-esp32-hub75/partitions.csv"
CONFIG_ESP_WIFI_STATIC_RX_BUFFER_NUM=4
CONFIG_ESP_WIFI_DYNAMIC_RX_BUFFER_NUM=8
CONFIG_MBEDTLS_DYNAMIC_BUFFER=y
# CONFIG_BT_ENABLED is not set
```
